## main/Kconfig.projbuild
```kconfig
menu "VapiCon 2025 Hardware Workshop Configuration"

    config WIFI_NAME
        string "WiFi Name"
        default ""
        help
            Enter your Wifi network name

    config WIFI_PASSWORD
        string "WiFi Password"
        default ""
        help
            Enter your Wifi network password

    config VAPI_PUBLIC_KEY
        string "Vapi Public Key"
        default "b3db41dc-f62e-4ca8-89dc-550eab564212"
        help
            Enter your Vapi Public Key

    config ASSISTANT_ID
        string "Assistant ID"
        default "0a46e2bc-8950-4a05-9970-cd239a47ad01"
        help
            Enter your Vapi Assistant ID

endmenu
```

## sdkconfig.defaults
```kconfig
CONFIG_IDF_TARGET="esp32s3"

# Enable PSRAM
CONFIG_SPIRAM_BOOT_INIT=y
CONFIG_SPIRAM=y
CONFIG_SPIRAM_MODE_OCT=y
CONFIG_SPIRAM_SPEED_80M=y
CONFIG_SPIRAM_USE_MALLOC=y
CONFIG_SPIRAM_MALLOC_ALWAYSINTERNAL=64
CONFIG_SPIRAM_MALLOC_RESERVE_INTERNAL=32768
CONFIG_FREERTOS_TASK_CREATE_ALLOW_EXT_MEM=y
CONFIG_SPIRAM_USE_CAPS_ALLOC=y
CONFIG_SPIRAM_TRY_ALLOCATE_WIFI_LWIP=y

# Performance
CONFIG_ESP_DEFAULT_CPU_FREQ_MHZ_240=y
CONFIG_FREERTOS_HZ=1000
CONFIG_COMPILER_OPTIMIZATION_PERF=y

# Enable DTLS
CONFIG_MBEDTLS_SSL_PROTO_DTLS=y

# Defaults to partitions.csv
CONFIG_ESPTOOLPY_FLASHSIZE_4MB=y
CONFIG_PARTITION_TABLE_CUSTOM=y

# libpeer requires large stack allocations
CONFIG_ESP_MAIN_TASK_STACK_SIZE=16384

# Disable task watchdog
CONFIG_ESP_TASK_WDT=n
CONFIG_ESP_TASK_WDT_PANIC=n

# Smaller default font
CONFIG_LV_FONT_DEFAULT_MONTSERRAT_12=y
CONFIG_LV_FONT_MONTSERRAT_12=y
```
